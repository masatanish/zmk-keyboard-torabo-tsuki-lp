## zmk-behavior-us-to-jis/Kconfig
```kconfig
# SPDX-License-Identifier: MIT

config ZMK_BEHAVIOR_US_TO_JIS
    bool
    default y
    help
      When enabled, build the us-to-jis mode behaviors and the keycode remapping
      listener. Linked only on the central half for split (see CMake).
```

## zmk-behavior-us-to-jis/dts/bindings/behaviors/zmk,behavior-us-to-jis-toggle.yaml
```yaml
# SPDX-License-Identifier: MIT
description: Set US->JIS host conversion mode to on or off (not a toggle of the key)
compatible: "zmk,behavior-us-to-jis-toggle"
include: zero_param.yaml
properties:
  toggle-mode:
    type: string
    required: true
    enum:
      - "on"
      - "off"
```
